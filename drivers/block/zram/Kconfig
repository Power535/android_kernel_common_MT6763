## drivers/block/zram/Kconfig
```kconfig
config ZRAM
	tristate "Compressed RAM block device support"
	depends on BLOCK && SYSFS && ZSMALLOC && CRYPTO
	select CRYPTO_LZO
	select CRYPTO_LZ4
	default n
	help
	  Creates virtual block devices called /dev/zramX (X = 0, 1, ...).
	  Pages written to these disks are compressed and stored in memory
	  itself. These disks allow very fast I/O and compression provides
	  good amounts of memory savings.

	  It has several use cases, for example: /tmp storage, use as swap
	  disks and maybe many more.

	  See Documentation/blockdev/zram.txt for more information.

config ZRAM_WRITEBACK
       bool "Write back incompressible page to backing device"
       depends on ZRAM
       default n
       help
	 With incompressible page, there is no memory saving to keep it
	 in memory. Instead, write it out to backing device.
	 For this feature, admin should set up backing device via
	 /sys/block/zramX/backing_dev.

	 See Documentation/blockdev/zram.txt for more information.

config ZRAM_MEMORY_TRACKING
	bool "Track zRam block status"
	depends on ZRAM && DEBUG_FS
	help
	  With this feature, admin can track the state of allocated blocks
	  of zRAM. Admin could see the information via
	  /sys/kernel/debug/zram/zramX/block_state.

	  See Documentation/blockdev/zram.txt for more information.

config HWZRAM_IMPL
       bool "Hardware version of ZRAM"
       default n
       help
        This is a hardware implementation layer for hwzram block device driver,
        which is used to control hardware operations of specific HW modules.
        This is used to replace ZRAM with faster HW compression/decompression
        or better compression ratio.
        If there is corresponding hardware module, please enable it.

config HWZRAM_DRV
       bool "Block device on top of hardware version of ZRAM"
       default n
       help
        Block device on top of hardware version of ZRAM.
        Before enabling HWZRAM_IMPL, you should enable this option.
        This imitates the implementation of ZRAM but with the hook of HW
        implementation in HWZRAM_IMPL.

config HWZRAM_DEBUG
       bool "Debug message for hardware version of ZRAM"
       default n
       help
        Debug option for hwzram driver.
        This is an option for development. You can enable it to
        get more information about HW compression/decompression
        flow and try to enhance it.

if HWZRAM_IMPL

source "drivers/block/zram/vendor/Kconfig"

endif # HWZRAM_IMPL
```
